## net/compat-drivers/drivers/net/wireless/ti/Kconfig
```kconfig
menuconfig WL_TI
	bool "TI Wireless LAN support"
	---help---
	  This section contains support for all the wireless drivers
	  for Texas Instruments WLAN chips, such as wl1251 and the wl12xx
	  family.

if WL_TI
source "net/compat-drivers/drivers/net/wireless/ti/wl1251/Kconfig"
source "net/compat-drivers/drivers/net/wireless/ti/wl12xx/Kconfig"
source "net/compat-drivers/drivers/net/wireless/ti/wl18xx/Kconfig"

# keep last for automatic dependencies
source "net/compat-drivers/drivers/net/wireless/ti/wlcore/Kconfig"
endif # WL_TI
```

## net/compat-wireless/drivers/staging/cw1200/Kconfig
```kconfig
config CW1200
       tristate "CW1200 WLAN support"
       select MAC80211
       select CFG80211
       help

         This is an experimental driver for the cw1200 chip-set.
         Enabling this option enables the generic driver without
         any platform support.

         Please select the appropriate platform below.

if CW1200

config CW1200_NON_POWER_OF_TWO_BLOCKSIZES
      bool "Platform supports non-power-of-two SDIO transfer"
      depends on CW1200
      help
        Say N here only if you are running the driver on a platform
        which does not have support for non-power-of-two SDIO transfer.
        If unsure, say Y.

config CW1200_USE_GPIO_IRQ
      bool "Use GPIO interrupt"
      depends on CW1200
      help
        Say Y here if you want to include GPIO IRQ support instead of SDIO IRQ.
        If unsure, say N.

config CW1200_5GHZ_SUPPORT
      bool "5GHz band support"
      depends on CW1200
      help
        Say Y if your device supports 5GHz band. Should be disabled for
        CW1100 silicon.
        If unsure, say N.

config CW1200_WAPI_SUPPORT
      bool "WAPI support"
      depends on CW1200
      help
        Say Y if your compat-wireless support WAPI.
        If unsure, say N.

config CW1200_USE_STE_EXTENSIONS
      bool "STE extensions"
      depends on CW1200
      help
        Say Y if you want to include STE extensions.
        If unsure, say N.

config CW1200_DISABLE_BEACON_HINTS
      bool "Disable 11d beacon hints"
      depends on CW1200
      help
        Say Y if you want to disable 11d beacon hints.
        If unsure, say N.

config CW1200_U5500_SUPPORT
      bool "Enable U5500 support"
      depends on CW1200
      help
        Say Y if you want to enable wlan on u5500 platform support.
        If unsure, say N.

menu "Driver debug features"
      depends on CW1200

config CW1200_DEBUGFS
      bool "Expose driver internals to DebugFS (DEVELOPMENT)"

config CW1200_BH_DEBUG
      bool "Enable low-level device communication logs (DEVELOPMENT)"

config CW1200_WSM_DEBUG
      bool "Enable WSM API debug messages (DEVELOPMENT)"

config CW1200_WSM_DUMPS
      bool "Verbose WSM API logging (DEVELOPMENT)"

config CW1200_WSM_DUMPS_SHORT
      bool "Dump only first x bytes (default 20) (DEVELOPMENT)"

config CW1200_TXRX_DEBUG
      bool "Enable TX/RX debug messages (DEVELOPMENT)"

config CW1200_TX_POLICY_DEBUG
      bool "Enable TX policy debug (DEVELOPMENT)"

config CW1200_STA_DEBUG
      bool "Enable STA/AP debug (DEVELOPMENT)"

config CW1200_DUMP_ON_ERROR
      bool "Dump kernel in case of critical error (DEVELOPMENT)"

endmenu

config CW1200_ITP
      bool "Enable ITP DebugFS"
      depends on CW1200
      help
        Say Y if you want to include ITP code.
        If unsure, say N.

endif
```
